LIST P = 16F877A
INCLUDE "P16F877A.INC"
__CONFIG h'3F31'
SAYAC EQU h'25'
GECIKMEE EQU h'27'
ORG 0X00
BASLA
BANKSEL TRISB
CLRF TRISB
CLRF TRISC
BANKSEL PORTB
CLRF PORTB
CLRF PORTC
MOVLW d'6'
MOVWF SAYAC
YAP

DECFSZ SAYAC,F
GOTO YAP1
MOVLW d'6'
MOVWF SAYAC
CLRF PORTC
INCF PORTC,F
BCF STATUS,C
CALL GECIKME
GOTO YAP
YAP1

MOVF SAYAC,0
CALL TABLO
MOVWF PORTB
CALL GECIKME
CALL GECIKME
RLF PORTC
BCF STATUS,C
GOTO YAP

GECIKME 
MOVLW h'FF'
MOVWF GECIKMEE
DON
DECFSZ GECIKMEE,F
GOTO DON
RETURN


TABLO
ADDWF PCL,F
RETLW b'0101010'
RETLW b'0101010'
RETLW b'0101010'
RETLW b'0110110'
RETLW b'0111110'
RETLW B'1000001'
end

;TABLO
;ADDWF PCL,F
;RETLW b'1000010'
;RETLW b'1111100'
;RETLW b'1111100'
;RETLW b'1111100'
;RETLW b'1111100'
;RETLW B'1000010'
