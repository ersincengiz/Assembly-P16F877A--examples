LIST P=16F877A
INCLUDE "P16F877A.INC"
__CONFIG h'3F31'
SAG EQU H'22'
SOL EQU h'23'
SAYAC EQU h'24'
GECIK EQU H'25'
GECIK2 EQU h'26'
ORG 0X00
GOTO BASLA
ORG 0X04
BTFSS PIR1,TMR1IF
RETFIE
BCF PIR1,TMR1IF
BANKSEL TMR1H
MOVLW h'3C'
MOVWF TMR1H
MOVLW h'B0'
MOVWF TMR1L

DECFSZ SAYAC,F
RETFIE
MOVLW D'5'
MOVWF SAYAC
GOTO SAGG
KESMECIK
RETFIE

BASLA
BANKSEL TRISB
CLRF TRISB
CLRF TRISA
BANKSEL PORTB
CLRF PORTB
CLRF PORTA
BANKSEL ADCON1
MOVLW h'06'
MOVWF ADCON1
BANKSEL INTCON
BSF INTCON,GIE
BSF INTCON,PEIE
BANKSEL PIE1
BSF PIE1,TMR1IE
BANKSEL TMR1H
MOVLW h'3C'
MOVWF TMR1H
MOVLW h'B0'
MOVWF TMR1L
BANKSEL T1CON
MOVLW h'11'
MOVWF T1CON
BANKSEL SAYAC
MOVLW d'5'
MOVWF SAYAC
CLRF SAG
CLRF SOL
DONGU 
CALL YAZ
GOTO DONGU

SAGG
MOVF SAG,W
SUBLW d'10'
BTFSC STATUS,C
GOTO SAGART
CLRF SAG
INCF SOL
MOVF SOL,W
SUBLW d'5'
BTFSS STATUS,C
GOTO SIFIRLA
GOTO KESMECIK
SAGART
INCF SAG,F
GOTO KESMECIK

YAZ
CALL GECIKMEE
BSF PORTA,1
BCF PORTA,0
MOVF SAG,W
CALL TABLO
MOVWF PORTB
CALL GECIKMEE
CLRF PORTB
BCF PORTA,1
BSF PORTA,0
MOVF SOL,W
CALL TABLO
MOVWF PORTB
NOP

RETURN
SIFIRLA
CLRF SAG
CLRF SOL
GOTO KESMECIK

TABLO
ADDWF PCL,F
RETLW H'3F'			;b'00111111'
RETLW H'06'			;b'00000110'
RETLW H'5B'			;b'01011011' 
RETLW H'4F'			;b'01001111'
RETLW H'66'			;b'01100110' 
RETLW H'6D'			;b'01101101' 
RETLW H'7D'			;b'01111101' 
RETLW H'07'			;b'00000111' 
RETLW H'7F'			;b'01111111' 
RETLW H'6F'			;b'01101111'
return

GECIKMEE
MOVLW h'FF'
MOVWF GECIK
DON 
DECFSZ GECIK,F
GOTO DON
RETURN
END