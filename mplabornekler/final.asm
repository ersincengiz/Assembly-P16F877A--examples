LIST P=16F877A
INCLUDE "P16F877A.INC"
__CONFIG H'3F31'
GECIK EQU H'22'
GECIK2 EQU H'21'
ALT EQU H'23'
UST EQU H'24'
VERI EQU H'25'
ORG 0X00
BASLA

BANKSEL TRISB
CLRF TRISB
CLRF TRISD
BANKSEL PORTB
CLRF PORTB
CLRF PORTD
MOVLW H'02'
CALL LCD_KUR
MOVLW h'0C'	
CALL LCD_KUR
MOVLW h'38'
MOVWF LCD_KUR
BANKSEL UST
MOVLW d'5'
MOVWF UST
MOVLW d'6'
MOVWF ALT
BSF PORTB,2
BCF PORTB,3

	DONGUUST
MOVF UST,W
MOVWF VERI
CALL TABLOAD

CALL LCD_VERI
DECFSZ UST,F
GOTO DONGUUST

call Satýr2


	DONGUALT
MOVF ALT,W
MOVWF VERI
CALL TABLOSOY
CALL LCD_VERI
DECFSZ ALT,F
GOTO DONGUALT

DONN
GOTO DONN

TABLOAD
ADDWF PCL,F
RETLW A'O'
RETLW A'N'
RETLW A'I'
RETLW A'S'
RETLW A'R'
RETLW A'E'



TABLOSOY
ADDWF PCL,F
RETLW A'O'
RETLW A'Z'
RETLW A'I'
RETLW A'G'
RETLW A'N'
RETLW A'E'
RETLW A'C'

Satýr2
MOVLW H'C0'
CALL LCD_KUR
return

GECIKME
MOVLW h'DD'
MOVWF GECIK
DON
MOVLW h'DD'
MOVWF GECIK2
DON1
DECFSZ GECIK2,F
GOTO DON1
DECFSZ GECIK,F
GOTO DON
RETURN


LCD_KUR
MOVWF PORTD
BCF PORTB,4
BSF PORTB,6
CALL GECIKME
BCF PORTB,6
nop
RETURN

LCD_VERI
MOVWF PORTD

BSF PORTB,4
BSF PORTB,6
CALL GECIKME
BCF PORTB,6
RETURN
END